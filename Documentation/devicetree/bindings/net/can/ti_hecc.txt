## Documentation/devicetree/bindings/net/can/ti_hecc.txt
```
* Texas Instruments High End CAN Controller

This file provides information, what the device node
for the hecc interface contains.

Required properties:
- compatible: "ti,am3505-hecc"
- reg: offset and length of the register set for the device
- interrupts: interrupt mapping for the hecc interrupts sources
- clocks: clock phandles (see clock bindings for details)
- ti,scc-ram-offset: offset to scc module ram
- ti,hecc-ram-offset: offset to hecc module ram
- ti,mbx-offset: offset to mailbox ram

Optional properties:
- ti,int-line: interrupt line

Example:

For am3517evm board:
	hecc: can@0x5c050000 {
		compatible = "ti,am3505-hecc";
		status = "disabled";
		reg = <0x5c050000 0x4000>;
		interrupts = <24>;
		clocks = <&hecc_ck>;
		ti,scc-ram-offset = <0x3000>;
		ti,hecc-ram-offset = <0x3000>;
		ti,mbx-offset = <0x2000>;
		ti,int-line = <0>;
	};
```

## Documentation/devicetree/bindings/power/bq27520.txt
```
Binding for TI bq7520 Li-Ion Charger
 
Required properties:
- compatible: "ti,bq27520"
- reg: integer, i2c address of the device.
- ti,enable-gpio: Should contain a phandle + gpio-specifier
to the GPIO pin connected to the chip's enable pin.
- ti,bat-good: Battery good gpio pin
- ti,soc_int: Interrupt gpio pin
```

## Documentation/devicetree/bindings/power/bq27xxx.txt
```
Binding for TI bq27xxx battery driver

Required properties:
- compatible:
	- "ti,bq27000" for bq27000, bq27200
	- "ti,bq27010" for bq27010, bq27210
	- "ti,bq27500" for bq27500, bq27510, bq27520
	- "ti,bq27530" for bq27530, bq27531
	- "ti,bq27541" for bq27541, bq27542, bq27546, bq27742
	- "ti,bq27545" for bq27545
	- "ti,bq27421" for bq27421, bq27425, bq27441, bq27621

Optional properties:
- reg: integer, i2c address of the device.
- ti,enable-gpio: Should contain a phandle + gpio-specifier
to the GPIO pin connected to the chip's enable pin.
- ti,bat-good: Battery good gpio pin
- ti,soc-int: Interrupt gpio pin
- ti,gpout: General Purpose open-drain output

Examples:

bq27520: bq27520@55 {
	compatible = "ti,bq27500";
	reg = <0x55>;
	ti,enable-gpio = <&gpio2 22 1>;
	ti,soc-int = <&gpio2 22 2>;
};
```

## Documentation/devicetree/bindings/video/backlight/am369fg06-backlight.txt
```
ams369fg06(tl2796) bindings

Required properties:
  - compatible: "samsung,ams369fg06-backlight"
  - reg: SPI chip select address of device
  - gpio-rst: reset GPIO pin

Example:
	backlight@0 {
		compatible = "samsung,ams369fg06-backlight";
		reg = <0>;
		gpio-rst = <&gpio4 2 GPIO_ACTIVE_LOW>;
		bl-name = "lcd-bl";
	};
```
